## ikemb001/linux/linux-2.6.14.1_v2.00/sound/arm/Kconfig
```kconfig
# ALSA ARM drivers

menu "ALSA ARM devices"
	depends on SND!=n && ARM
	
config SND_S3C2410_UDA1341
        tristate "S3C2410 UDA1341TS driver"
	depends on ARCH_S3C2410 && SND
        select SND_PCM
	select SND_GENERIC_DRIVER
	help
	Say Y here if you have a Compaq iPaq H3x00 handheld computer
	and want to use its Philips UDA 1341 audio chip.
	
	To compile this driver as a module, choose M here: the module
	will be called snd-s3c2410-uda1341.

config SND_SA11XX_UDA1341
	tristate "SA11xx UDA1341TS driver (iPaq H3600)"
	depends on ARCH_SA1100 && SND && L3
	select SND_PCM
	select SND_GENERIC_DRIVER
	help
	  Say Y here if you have a Compaq iPaq H3x00 handheld computer
	  and want to use its Philips UDA 1341 audio chip.

	  To compile this driver as a module, choose M here: the module
	  will be called snd-sa11xx-uda1341.

config SND_ARMAACI
	tristate "ARM PrimeCell PL041 AC Link support"
	depends on SND && ARM_AMBA
	select SND_PCM
	select SND_AC97_CODEC

config SND_PXA2XX_PCM
	tristate
	select SND_PCM

config SND_PXA2XX_AC97
	tristate "AC97 driver for the Intel PXA2xx chip"
	depends on ARCH_PXA && SND
	select SND_PXA2XX_PCM
	select SND_AC97_CODEC
	help
	  Say Y or M if you want to support any AC97 codec attached to
	  the PXA2xx AC97 interface.

endmenu
```

## ikemb002/linux/linux-2.6.20-snd/arch/powerpc/platforms/83xx/Kconfig
```kconfig
menu "Platform support"
	depends on PPC_83xx

choice
	prompt "Machine Type"
	default MPC834x_SYS

config MPC8313_RDB
	bool "Freescale MPC8313 RDB"
	select DEFAULT_UIMAGE
	help
	  This option enables support fro the MPC8313 RDB board.

config MPC832x_MDS
	bool "Freescale MPC832x MDS"
	select DEFAULT_UIMAGE
	select QUICC_ENGINE
	help
	  This option enables support for the MPC832x MDS evaluation board.

config MPC834x_SYS
	bool "Freescale MPC834x SYS"
	select DEFAULT_UIMAGE
	help
	  This option enables support for the MPC 834x SYS evaluation board.

	  Be aware that PCI buses can only function when SYS board is plugged
	  into the PIB (Platform IO Board) board from Freescale which provide
	  3 PCI slots.  The PIBs PCI initialization is the bootloader's
	  responsibility.

config MPC834x_ITX
	bool "Freescale MPC834x ITX"
	select DEFAULT_UIMAGE
	help
	  This option enables support for the MPC 834x ITX evaluation board.

	  Be aware that PCI initialization is the bootloader's
	  responsibility.

config MPC8360E_PB
	bool "Freescale MPC8360E PB"
	select DEFAULT_UIMAGE
	select QUICC_ENGINE
	help
	  This option enables support for the MPC836x EMDS Processor Board.

endchoice

config PPC_MPC831x
	bool
	select PPC_UDBG_16550
	select PPC_INDIRECT_PCI
	select USB_EHCI_FSL
	default y if MPC8313_RDB

config PPC_MPC832x
	bool
	select PPC_UDBG_16550
	select PPC_INDIRECT_PCI
	default y if MPC832x_MDS

config MPC834x
	bool
	select PPC_UDBG_16550
	select PPC_INDIRECT_PCI
	select USB_EHCI_FSL
	default y if MPC834x_SYS || MPC834x_ITX

config PPC_MPC836x
	bool
	select PPC_UDBG_16550
	select PPC_INDIRECT_PCI
	default y if MPC8360E_PB

config PPC_83xx_PM
	bool
	default y
	depends on PPC_83xx && PM
	select PPC32_SUSPEND

config MPC83xx_GTM
	tristate "83xx General-Purpose Timers for PM wakeup"
	help
	  This enables a driver for the GTM4 timer, to be used
	  as a wakeup source for suspend-to-RAM.  To arm the
	  timer, write the number of seconds until expiration
	  to the "timeout" file in the device's sysfs directory.
	  To disarm, write 0 to the "timeout" file.

endmenu
```

## ikemb002/linux/linux-2.6.20-usb/arch/powerpc/oprofile/Kconfig
```kconfig
config PROFILING
	bool "Profiling support (EXPERIMENTAL)"
	help
	  Say Y here to enable the extended profiling support mechanisms used
	  by profilers such as OProfile.


config OPROFILE
	tristate "OProfile system profiling (EXPERIMENTAL)"
	depends on PROFILING
	help
	  OProfile is a profiling system capable of profiling the
	  whole system, include the kernel, kernel modules, libraries,
	  and applications.

	  If unsure, say N.

config OPROFILE_E300
	bool "Profiling support on the e300 core"
	depends on OPROFILE
	depends on 6xx
	help
	 Select this option when running on an e300 PowerPC core
	 If unsure, say N.
```
